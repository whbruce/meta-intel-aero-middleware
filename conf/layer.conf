## conf/layer.conf
```bitbake
# We have a conf and classes directory, add to BBPATH
BBPATH .= ":${LAYERDIR}"

# We have recipes-* directories, add to BBFILES
BBFILES += "${LAYERDIR}/recipes-*/*/*.bb \
	${LAYERDIR}/recipes-*/*/*.bbappend"

BBFILE_COLLECTIONS += "meta-intel-aero-uav"
BBFILE_PATTERN_meta-intel-aero-uav = "^${LAYERDIR}/"
BBFILE_PRIORITY_meta-intel-aero-uav = "6"
```
